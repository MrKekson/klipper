## src/lpc176x/Kconfig
```kconfig
# Kconfig settings for LPC176x processors

if MACH_LPC176X

config LPC_SELECT
    bool
    default y
    select HAVE_GPIO
    select HAVE_GPIO_ADC

config BOARD_DIRECTORY
    string
    default "lpc176x"

config CLOCK_FREQ
    int
    default 24000000 # 96000000 / 4

config SMOOTHIEWARE_BOOTLOADER
    bool "Target board uses Smoothieware bootloader"
    default y

config FLASH_START
    hex
    default 0x4000 if SMOOTHIEWARE_BOOTLOADER
    default 0x0000

config USBSERIAL
    bool "Use USB for communication (instead of serial)"
    default y
config SERIAL
    depends on !USBSERIAL
    bool
    default y
config SERIAL_BAUD
    depends on SERIAL
    int "Baud rate for serial port"
    default 250000

endif
```
